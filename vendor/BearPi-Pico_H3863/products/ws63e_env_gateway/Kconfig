## vendor/BearPi-Pico_H3863/products/ws63e_env_gateway/Kconfig
```kconfig
#===============================================================================
# @brief    Kconfig file for WS63E Environment Gateway
# Copyright (c) @CompanyNameMagicTag 2023-2023. All rights reserved.
#===============================================================================

comment "BearPi-Pico H3863 Wi-Fi + SLE gateway"
    depends on SAMPLE_SUPPORT_WS63E_ENV_GATEWAY

config WS63E_ENV_GATEWAY_ROUTER_SSID
    string "Router Wi-Fi SSID for STA mode"
    default "SugarLab"
    depends on SAMPLE_SUPPORT_WS63E_ENV_GATEWAY
    help
        Router Wi-Fi SSID used by the gateway before falling back to SoftAP.

config WS63E_ENV_GATEWAY_ROUTER_PASSWORD
    string "Router Wi-Fi password for STA mode"
    default "wifia302"
    depends on SAMPLE_SUPPORT_WS63E_ENV_GATEWAY
    help
        Router Wi-Fi password used by the gateway before falling back to SoftAP.
```
